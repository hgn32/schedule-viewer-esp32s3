## sdkconfig.defaults
```kconfig
# idf.py set-target esp32s3 で生成されるsdkconfigの初期値。
# 直接sdkconfigを編集せず、恒久的な変更はこのファイルに書いてsdkconfigを作り直す。

CONFIG_IDF_TARGET="esp32s3"

# --- フラッシュ (ESP32-S3-WROOM-1-N16R8: 16MB QIO) --------------------------
CONFIG_ESPTOOLPY_FLASHSIZE_16MB=y
CONFIG_ESPTOOLPY_FLASHSIZE="16MB"
CONFIG_ESPTOOLPY_FLASHMODE_QIO=y
CONFIG_ESPTOOLPY_FLASHFREQ_80M=y
CONFIG_ESP_DEFAULT_CPU_FREQ_MHZ_240=y

# --- パーティション --------------------------------------------------------
CONFIG_PARTITION_TABLE_CUSTOM=y
CONFIG_PARTITION_TABLE_CUSTOM_FILENAME="partitions.csv"

# --- PSRAM (ESP32-S3-WROOM-1-N16R8: 8MB Octal) ------------------------------
# RGB LCD表示中にフラッシュアクセスが割り込むと画面が乱れるため、
# 命令とrodataをPSRAMへ退避する(Waveshare公式サンプルと同じ設定)。
CONFIG_SPIRAM=y
CONFIG_SPIRAM_MODE_OCT=y
CONFIG_SPIRAM_SPEED_80M=y
CONFIG_SPIRAM_USE_MALLOC=y
CONFIG_SPIRAM_MALLOC_ALWAYSINTERNAL=4096
CONFIG_SPIRAM_FETCH_INSTRUCTIONS=y
CONFIG_SPIRAM_RODATA=y

# --- コンソール -------------------------------------------------------------
# コンソールはネイティブUSB(USB-Serial/JTAG、COM4)側に置く。UART0は未使用。
# UART0を主コンソールにすると、ホストが接続してからでないと初期化されない仕様の
# ため書き込み後に監視を開いても無音になり、ログが一切取得できなかった
# (2026-09-12に確認)。下のログ設定で出力自体を止めているので現状この経路に
# 流れるものは無いが、切り分けのためにログを戻したときの出力先はここになる。
CONFIG_ESP_CONSOLE_USB_SERIAL_JTAG=y
CONFIG_ESP_CONSOLE_UART_BAUDRATE=115200

# --- ログ -------------------------------------------------------------------
# 運用中(壁掛け・PC非接続)はログの出力先が無く誰も読まないため、一切出さない。
# アプリのESP_LOG*はソースから撤去済み。ここで止めるのはESP-IDF内部
# (wifi: / esp_image: / heap_init など)とブートローダの出力。
# 切り分けのために戻すときはこの2行を消して再ビルドする(戻るのはIDF内部の
# ログだけで、アプリのログはソースに無いので戻らない)。
# なおROMのブートログ(ESP-ROM: / rst:0x... / boot:0x...)はeFuseでしか
# 止められないため、これらは止めても出る。
CONFIG_LOG_DEFAULT_LEVEL_NONE=y
CONFIG_BOOTLOADER_LOG_LEVEL_NONE=y

# --- TLS (予定取得APIのHTTPS) ---------------------------------------------
# サーバ証明書は*.asahi-kasei.co.jp ← GlobalSign RSA OV SSL CA 2018 ←
# GlobalSign Root CA - R3。いずれもESP-IDF同梱の公的CAバンドルに含まれるので、
# 証明書をアプリへ埋め込まずesp_crt_bundleで検証する。
CONFIG_MBEDTLS_CERTIFICATE_BUNDLE=y
CONFIG_MBEDTLS_CERTIFICATE_BUNDLE_DEFAULT_FULL=y
# TLSのレコード長。既定の16KBは内蔵RAMを圧迫するので入出力を分けて絞る。
# サーバが16KBのフラグメントを送ってくる場合はIN側を戻すこと。
CONFIG_MBEDTLS_ASYMMETRIC_CONTENT_LEN=y
CONFIG_MBEDTLS_SSL_IN_CONTENT_LEN=16384
CONFIG_MBEDTLS_SSL_OUT_CONTENT_LEN=4096

# --- ランタイム ------------------------------------------------------------
CONFIG_FREERTOS_HZ=1000
# TLSハンドシェイクはmainタスクのスタック上で走る。8192では足りない。
# さらにFreeTypeのラスタライザがスタックを大きく使う(46pxの描画で16384では
# スタックオーバーフローして再起動する。旧M5Paper版で2026-09-01に実機で確認)ため
# 32768にする。
CONFIG_ESP_MAIN_TASK_STACK_SIZE=32768
CONFIG_COMPILER_CXX_EXCEPTIONS=n
CONFIG_COMPILER_OPTIMIZATION_SIZE=y
```
